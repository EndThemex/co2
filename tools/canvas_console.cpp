// ============================================================================
// ConsoleCanvas implementation (pixel-per-character).
// ============================================================================

#include "canvas_console.h"

#include <cstdio>
#include <cstring>
#include <cstdlib>
#include <algorithm>

// 5x7 ASCII font (subset 0x20..0x7E), same shape as Adafruit GFX glcdfont.c.
// 5 bytes per char, only the low 5 bits used; bit (1<<row) = "lit" pixel.
static const unsigned char FONT_5x7[][5] = {
    {0x00, 0x00, 0x00, 0x00, 0x00}, // 0x20 ' '
    {0x00, 0x00, 0x5F, 0x00, 0x00}, // 0x21 '!'
    {0x00, 0x07, 0x00, 0x07, 0x00}, // 0x22 '"'
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    {0x10, 0x08, 0x08, 0x10, 0x10}, // 0x7E '~'
};

// 0xF8 '°' degree sign — same glyph as Adafruit GFX glcdfont.c char 0xF8.
static const unsigned char DEGREE_GLYPH[5] = {0x06, 0x0F, 0x09, 0x0F, 0x06};

static const unsigned char *font5x7_or_default(char c)
{
    if ((unsigned char)c == 0xF8)
        return DEGREE_GLYPH;
    if (c < 0x20 || c > 0x7E)
        return FONT_5x7[0]; // fallback to space
    return FONT_5x7[c - 0x20];
}

ConsoleCanvas::ConsoleCanvas()
{
    clear();
}

void ConsoleCanvas::clear()
{
    for (int y = 0; y < H; ++y)
        for (int x = 0; x < W; ++x)
            buf_[y][x] = '.';
}

void ConsoleCanvas::set_pixel(int px, int py)
{
    if (px < 0 || px >= W || py < 0 || py >= H)
        return;
    buf_[py][px] = '#';
}

void ConsoleCanvas::put_glyph_pixel(int px, int py, char /*ch*/, int /*size*/)
{
    // Always light exactly one OLED pixel; caller already handles `size`
    // by repeating the call for each scaled pixel.
    set_pixel(px, py);
}

void ConsoleCanvas::draw_line(int x0, int y0, int x1, int y1)
{
    // Bresenham integer line algorithm; every lit pixel becomes a '#'.
    int dx = std::abs(x1 - x0), sx = (x0 < x1) ? 1 : -1;
    int dy = -std::abs(y1 - y0), sy = (y0 < y1) ? 1 : -1;
    int err = dx + dy;

    while (true)
    {
        set_pixel(x0, y0);
        if (x0 == x1 && y0 == y1)
            break;
        int e2 = 2 * err;
        if (e2 >= dy)
        {
            err += dy;
            x0 += sx;
        }
        if (e2 <= dx)
        {
            err += dx;
            y0 += sy;
        }
    }
}

void ConsoleCanvas::draw_text(int x, int y, int size, const char *s)
{
    if (!s)
        return;
    // The 5x7 glyph is laid out as 5 columns x 7 rows. Each "glyph pixel"
    // is repeated `size` times in X and `size` times in Y when size > 1.
    int cx = x;
    int cy = y;
    int char_pitch = 6 * size; // 5 columns + 1 spacing column

    for (const char *p = s; *p; ++p)
    {
        const unsigned char *glyph = font5x7_or_default(*p);
        for (int col = 0; col < 5; ++col)
        {
            unsigned char bits = glyph[col];
            for (int row = 0; row < 7; ++row)
            {
                if (bits & (1 << row))
                {
                    for (int dy = 0; dy < size; ++dy)
                        for (int dx = 0; dx < size; ++dx)
                            put_glyph_pixel(cx + col * size + dx,
                                            cy + row * size + dy, *p, size);
                }
            }
        }
        cx += char_pitch;
        if (cx >= W)
            break;
    }
}

void ConsoleCanvas::flush()
{
    // ANSI: clear screen + cursor home
    std::fputs("\x1b[2J\x1b[H", stdout);

    // Top border
    std::printf("+");
    for (int x = 0; x < W; ++x)
        std::printf("-");
    std::printf("+\n");

    for (int y = 0; y < H; ++y)
    {
        std::printf("|");
        std::fwrite(buf_[y], 1, W, stdout); // write exactly W chars (no NUL terminator)
        std::printf("|\n");
    }

    // Bottom border
    std::printf("+");
    for (int x = 0; x < W; ++x)
        std::printf("-");
    std::printf("+\n");
    std::fflush(stdout);
}